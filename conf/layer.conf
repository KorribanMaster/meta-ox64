## conf/layer.conf
```bitbake
# We have a conf and classes directory, add to BBPATH
BBPATH .= ":${LAYERDIR}"

# We have recipes-* directories, add to BBFILES
BBFILES += "${LAYERDIR}/recipes-*/*/*.bb \
            ${LAYERDIR}/recipes-*/*/*.bbappend"

BBFILE_COLLECTIONS += "meta-ox64"
BBFILE_PATTERN_meta-ox64 = "^${LAYERDIR}/"
BBFILE_PRIORITY_meta-ox64 = "6"

LAYERDEPENDS_meta-ox64 = "core meta-openbouffalo"
LAYERSERIES_COMPAT_meta-ox64 = "kirkstone"
LAYERVERSION_COMPAT_meta-ox64 = "1"
```
